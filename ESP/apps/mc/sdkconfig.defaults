## ESP/apps/mc/sdkconfig.defaults
```kconfig
CONFIG_RAVEN_MISSION_COMPUTER=y
CONFIG_RAVEN_MAX_SESSIONS=6
CONFIG_BT_ENABLED=y
CONFIG_BT_BLUEDROID_ENABLED=n
CONFIG_BT_NIMBLE_ENABLED=y
CONFIG_BT_NIMBLE_MAX_CONNECTIONS=1
CONFIG_BT_NIMBLE_ROLE_CENTRAL=n
CONFIG_BT_NIMBLE_ROLE_OBSERVER=n
CONFIG_BT_NIMBLE_ATT_PREFERRED_MTU=185
CONFIG_BT_NIMBLE_MSYS_1_BLOCK_COUNT=8
CONFIG_BT_NIMBLE_MSYS_2_BLOCK_COUNT=8
CONFIG_BT_NIMBLE_TRANSPORT_ACL_FROM_LL_COUNT=8
CONFIG_ESP_COEX_SW_COEXIST_ENABLE=y
CONFIG_RAVEN_BLE_ENABLED=y
CONFIG_ESP_CONSOLE_USB_SERIAL_JTAG=y
```

## ESP/components/raven_app/Kconfig
```kconfig
menu "Raven device profile"
config RAVEN_MISSION_COMPUTER
    bool "Mission computer (AP/server)"
    default n
config RAVEN_MAX_SESSIONS
    int "MC simultaneous TCP sessions (resource profile)"
    range 1 10
    default 6
    depends on RAVEN_MISSION_COMPUTER
config RAVEN_TCP_PORT
    int "Device ICD TCP port"
    range 1024 65535
    default 8080
config RAVEN_WIFI_SSID
    string "Shared development network SSID"
    default "Raven-Link"
config RAVEN_WIFI_PASSWORD
    string "Shared development network password"
    default "raven-link"
config RAVEN_BLE_ENABLED
    bool "BLE service console"
    depends on RAVEN_MISSION_COMPUTER && BT_NIMBLE_ENABLED
    default y
config RAVEN_VALIDATION_MONITOR
    bool "Test-only UART resource and peer snapshots"
    default n
    help
        Adds a low-priority 3072-byte task which prints heap/stack and peer
        snapshots every ten seconds. Only for hardware validation builds;
        production BLE and UART diagnostics remain event-driven.
config RAVEN_TCP_BOARD_PROBE
    bool "Test-only node: exercise six MC TCP sessions"
    depends on !RAVEN_MISSION_COMPUTER
    default n
    help
        Replaces normal node composition with the physical TCP validation
        client. Disconnect normal nodes before running this test profile.
endmenu
```

## ESP/examples/device_communication/sdkconfig.defaults
```kconfig
CONFIG_PARTITION_TABLE_CUSTOM=y
CONFIG_PARTITION_TABLE_CUSTOM_FILENAME="../partitions.csv"
CONFIG_LWIP_SO_LINGER=y
CONFIG_LWIP_MAX_SOCKETS=10
CONFIG_LWIP_MAX_ACTIVE_TCP=16
CONFIG_LWIP_MAX_LISTENING_TCP=1
CONFIG_LWIP_TCP_SND_BUF_DEFAULT=2880
CONFIG_LWIP_TCP_WND_DEFAULT=2880
CONFIG_LWIP_TCP_QUEUE_OOSEQ=n
CONFIG_LWIP_TCP_OVERSIZE_MSS=y
CONFIG_LWIP_L2_TO_L3_COPY=y
CONFIG_ESP_WIFI_STATIC_RX_BUFFER_NUM=6
CONFIG_ESP_WIFI_DYNAMIC_RX_BUFFER_NUM=6
CONFIG_ESP_WIFI_DYNAMIC_TX_BUFFER_NUM=6
CONFIG_ESP_WIFI_RX_BA_WIN=6
CONFIG_LOG_COLORS=n
CONFIG_FREERTOS_HZ=100
CONFIG_ESP_TASK_WDT_EN=y
CONFIG_ESP_TASK_WDT_INIT=y
```

## ESP/raven/main/Kconfig.projbuild
```kconfig
menu "Raven architecture demo"
config RAVEN_RND_RUNTIME
    bool "Run the virtual two-arm architecture prototype"
    default y
    select LWIP_SO_LINGER
    help
        Runs mock actuators, independent owner tasks, TCP delivery receipts,
        operation status polling and telemetry. Does not drive actuator GPIOs.
config RAVEN_RND_SELF_TEST
    bool "Run deterministic and TCP loopback tests at boot"
    default n
    depends on RAVEN_RND_RUNTIME
config RAVEN_BLE_ENABLED
    bool "Bluetooth Serial Connect server (FFE0/FFE1)"
    default y
    depends on RAVEN_RND_RUNTIME && BT_NIMBLE_ENABLED
    help
        Advertises Raven-BLE and exposes a newline ASCII console and demo controls.
        Uses simulated arms. Subscribe to FFE1 notifications before writing.
config RAVEN_RND_PORT
    int "Incoming TCP command port"
    range 1024 65535
    default 8080
config RAVEN_RND_WIFI_SSID
    string "Station SSID (empty starts the Raven-RND development AP)"
    default ""
config RAVEN_RND_WIFI_PASSWORD
    string "Station password"
    default ""
config RAVEN_RND_TELEMETRY_HOST
    string "Outbound telemetry IPv4 (empty disables external telemetry)"
    default ""
config RAVEN_RND_TELEMETRY_PORT
    int "Outbound telemetry port"
    range 1024 65535
    default 8080
endmenu

menu "Raven Flight Controller"

config RAVEN_FC_LINK_ENABLED
    bool "Enable Betaflight MSP link"
    default n
    help
        Enable the dedicated full-duplex UART link between Raven and the
        Betaflight flight controller. Keep this disabled until the physical
        UART pads, ESP32-S3 GPIOs, and power wiring have been verified.

if RAVEN_FC_LINK_ENABLED

config RAVEN_FC_UART_PORT
    int "ESP32-S3 UART controller"
    range 1 2
    default 1
    help
        UART0 is intentionally excluded so the product link cannot silently
        take over the default console UART.

config RAVEN_FC_UART_TX_GPIO
    int "ESP32-S3 TX GPIO"
    range 0 48
    default 17

config RAVEN_FC_UART_RX_GPIO
    int "ESP32-S3 RX GPIO"
    range 0 48
    default 18

config RAVEN_FC_MSP_BAUD
    int "MSP baud rate"
    range 9600 1000000
    default 115200

config RAVEN_FC_UART_RX_BUFFER_SIZE
    int "UART RX ring buffer size"
    range 256 8192
    default 2048

config RAVEN_FC_POLL_PERIOD_MS
    int "Link-health polling period (ms)"
    range 100 10000
    default 1000

config RAVEN_FC_RESPONSE_TIMEOUT_MS
    int "MSP response timeout (ms)"
    range 20 2000
    default 250

config RAVEN_FC_DISCONNECT_FAILURES
    int "Failures before link-down"
    range 1 20
    default 3

endif

endmenu
```
